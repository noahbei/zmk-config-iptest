#include <behaviors.dtsi>
#include <dt-bindings/zmk/keys.h>
#include <dt-bindings/zmk/bt.h>
#include <dt-bindings/zmk/ext_power.h>

#define DEFAULT 0
#define BTLY 1

/ {
    keymap {
        compatible = "zmk,keymap";

        default_layer {
        // -------------------------------------------------------------------------------------------------------------------------
        // |    A    |    B    |    C    |    D    |    X    |    bt   |
        // |    E    |    F    |    G    |    H
        // |    I    |    Z    |    J    |    K
        // -------------------------------------------------------------------------------------------------------------------------
            bindings = <
                &kp A
            >;
        };
    };
};