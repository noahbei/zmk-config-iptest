## boards/arm/improvedpad/Kconfig.board
```kconfig
config BOARD_IMPROVEDPAD
    bool "improvedpad"
    depends on SOC_NRF52833_QDAA
```

## boards/arm/improvedpad/Kconfig.defconfig
```kconfig
if BOARD_IMPROVEDPAD

config BOARD
    default "improvedpad"

if USB_DEVICE_STACK

config USB_NRFX
    default y

endif # USB_DEVICE_STACK

config BT_CTLR
    default BT

config MAX17048
	default y

config BOARD_NRFMICRO_CHARGER
    default y

endif # BOARD_IMPROVEDPAD
```

## boards/arm/improvedpad/improvedpad_defconfig
```kconfig
# SPDX-License-Identifier: MIT

CONFIG_SOC_SERIES_NRF52X=y
CONFIG_SOC_NRF52833_QDAA=y
CONFIG_BOARD_IMPROVEDPAD=y

# Enable MPU
CONFIG_ARM_MPU=y

CONFIG_PINCTRL=y

# Enable GPIO
CONFIG_GPIO=y

# Enable Flash settings
CONFIG_USE_DT_CODE_PARTITION=y
CONFIG_BUILD_OUTPUT_UF2=y
CONFIG_MPU_ALLOW_FLASH_WRITE=y
CONFIG_NVS=y
CONFIG_SETTINGS_NVS=y
CONFIG_FLASH=y
CONFIG_FLASH_PAGE_LAYOUT=y
CONFIG_FLASH_MAP=y

# Enable Clock control
CONFIG_CLOCK_CONTROL_NRF=y
CONFIG_CLOCK_CONTROL_NRF_K32SRC_RC=y

# Enable ZMK features
CONFIG_ZMK_USB=y
CONFIG_ZMK_BLE=y

# Enable UART
CONFIG_SERIAL=y
CONFIG_UART_INTERRUPT_DRIVEN=n
#CONFIG_UART_0_NRF_UARTE=y

# Enable Bluetooth settings
CONFIG_BT=y
CONFIG_BT_HCI=y
CONFIG_BT_CTLR=y
CONFIG_BT_LL_SW_SPLIT=y
CONFIG_BT_HCI_UART=y
CONFIG_BT_HCI_UART_NO_RECONFIG=y

# Additional settings if needed
CONFIG_MAIN_STACK_SIZE=2048

# Logging settings (if applicable)
CONFIG_LOG=y
#CONFIG_USE_SEGGER_RTT=y
#CONFIG_RTT_CONSOLE=y
#CONFIG_UART_CONSOLE=n
#CONFIG_LOG_BACKEND_UART=y
```
