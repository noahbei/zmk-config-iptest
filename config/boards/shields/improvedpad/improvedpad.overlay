#include "improvedpad.dtsi"

/ {
    chosen {
        zmk,kscan = &kscan0;
        zmk,matrix-transform = &default_transform;
    };

    kscan0: kscan {
        compatible = "zmk,kscan-gpio-matrix";
        wakeup-source;

        diode-direction = "col2row";
        row-gpios
            = <&expander 1 (GPIO_ACTIVE_HIGH | GPIO_PULL_DOWN)>
            , <&expander 2 (GPIO_ACTIVE_HIGH | GPIO_PULL_DOWN)>
            , <&expander 3 (GPIO_ACTIVE_HIGH | GPIO_PULL_DOWN)>
            , <&expander 4 (GPIO_ACTIVE_HIGH | GPIO_PULL_DOWN)>
            ;
        col-gpios
            = <&expander 9 GPIO_ACTIVE_HIGH>
            , <&expander 10 GPIO_ACTIVE_HIGH>
            , <&expander 11 GPIO_ACTIVE_HIGH>
            , <&expander 2 GPIO_ACTIVE_HIGH>
            , <&expander 23 GPIO_ACTIVE_HIGH>
            , <&expander 24 GPIO_ACTIVE_HIGH>
            ;
    };
};
