#include <nordic/nrf52833_qdaa.dtsi>
//#include "improvedpad.dtsi"
/ {
    chosen {
        zmk,kscan = &kscan0;
    };
    
    kscan0: kscan_0 {
        compatible = "zmk,kscan-gpio-matrix";
        diode-direction = "col2row";
        wakeup-source;

        col-gpios
            = <&right_io 7 GPIO_ACTIVE_HIGH>
            , <&right_io 6 GPIO_ACTIVE_HIGH>
            , <&right_io 5 GPIO_ACTIVE_HIGH>
            , <&right_io 4 GPIO_ACTIVE_HIGH>
            ;

        row-gpios
            = <&right_io 0 (GPIO_ACTIVE_HIGH | GPIO_PULL_DOWN)>
            , <&right_io 1 (GPIO_ACTIVE_HIGH | GPIO_PULL_DOWN)>
            , <&right_io 2 (GPIO_ACTIVE_HIGH | GPIO_PULL_DOWN)>
            , <&right_io 3 (GPIO_ACTIVE_HIGH | GPIO_PULL_DOWN)>
            ;
    };

    // &spi1 {
    //     status = "okay";
    //     // sck-pin = <17>;
    //     // mosi-pin = <14>;
    //     // miso-pin = <15>;
    //     // cs-gpios = <&gpio0 11 GPIO_ACTIVE_LOW>;
    //     compatible = "nordic,nrf-spim";
    //     pinctrl-0 = <&spi1_default>;
    //     pinctrl-1 = <&spi1_sleep>;
    //     pinctrl-names = "default", "sleep";
    // };

};